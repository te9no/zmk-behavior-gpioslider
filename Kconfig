## Kconfig
```kconfig
DT_COMPAT_ZMK_BEHAVIOR_GPIOSLIDER := zmk,behavior-gpioslider

config ZMK_BEHAVIOR_GPIOSLIDER
    bool
    default $(dt_compat_enabled,$(DT_COMPAT_ZMK_BEHAVIOR_GPIOSLIDER))
```

## dts/bindings/behaviors/zmk,behavior-gpioslider.yaml
```yaml
description: GPIO Slider behavior
compatible: "zmk,behavior-gpioslider"

include: zero_param.yaml

properties:
  label:
    type: string
    required: true
    description: Unique label for the GPIO slider

  gpio-keys-buttons:
    type: phandle-array
    required: true
    description: GPIO pins to be used for slider buttons (up to 4 pins)

  num-buttons:
    type: int
    required: true
    description: Number of buttons used in the slider (1-4)
    
  sequence-up:
    type: array
    required: true
    description: Sequence of button numbers for upward movement

  sequence-down:
    type: array
    required: true
    description: Sequence of button numbers for downward movement

  bindings:
    type: phandle-array
    required: true
    description: Key bindings for up and down movements

  debounce-period:
    type: int
    default: 30
    description: Debounce period in milliseconds

  sequence-timeout:
    type: int
    default: 1000
    description: Timeout in milliseconds for sequence recognition
```
