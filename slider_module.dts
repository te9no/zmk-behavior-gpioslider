/ {
    behaviors {
        gpioslider: gpioslider {
            compatible = "zmk,behavior-gpioslider";
            // ...existing code...
        };
    };

    gpioslider_keys {
        compatible = "zmk,gpioslider-keys";
        // ...existing code...
    };
};
